/ {
    compatible = "zmk,keyboard";

    chosen {
        zmk,keyboard = &kscan0;
    };
};

&kscan0 {
    row-gpios = <&gpio0 10 GPIO_ACTIVE_LOW>,
                <&gpio0 11 GPIO_ACTIVE_LOW>,
                <&gpio0 12 GPIO_ACTIVE_LOW>,
                <&gpio0 13 GPIO_ACTIVE_LOW>;  // thumb row
    col-gpios = <&gpio0 4 GPIO_ACTIVE_LOW>,
                <&gpio0 5 GPIO_ACTIVE_LOW>,
                <&gpio0 6 GPIO_ACTIVE_LOW>,
                <&gpio0 7 GPIO_ACTIVE_LOW>,
                <&gpio0 8 GPIO_ACTIVE_LOW>;
};
